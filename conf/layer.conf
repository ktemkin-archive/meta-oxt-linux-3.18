## conf/layer.conf
```bitbake
# We have a conf and classes directory, append to BBPATH
BBPATH .= ":${LAYERDIR}"

# We have a recipes directory, add to BBFILES
BBFILES += "${LAYERDIR}/recipes-*/*/*.bb ${LAYERDIR}/recipes-*/*/*.bbappend"

BBFILE_COLLECTIONS += "linux-318-layer"
BBFILE_PATTERN_linux-318-layer := "^${LAYERDIR}/"

# Define the priority for recipes (.bb files) from this layer,
# choosing carefully how this layer interacts with all of the
# other layers.

BBFILE_PRIORITY_linux-318-layer = "100"

#Force linux 3.18 on everyone.
PREFERRED_VERSION_linux-libc-headers = "3.18%"
PREFERRED_VERSION_linux-libc-headers-nativesdk = "${PREFERRED_VERSION_linux-libc-headers}"
PREFERRED_VERSION_linux-xenclient-dom0 = "3.18%"
PREFERRED_VERSION_linux-xenclient-ndvm = "3.18%"
PREFERRED_VERSION_linux-xenclient-nilfvm = "3.18%"
PREFERRED_VERSION_linux-xenclient-stubdomain = "3.18%"
PREFERRED_VERSION_linux-xenclient-syncvm = "3.18%"
PREFERRED_VERSION_linux-xenclient-uivm = "3.18%"
```
